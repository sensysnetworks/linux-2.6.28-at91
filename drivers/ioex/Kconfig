## drivers/ioex/Kconfig
```kconfig
#
# IO expansion configuration
#

menu "IO expansion"

config ECOREEX
        tristate "EMAC cores"
        ---help---
        Provides autodetection and support for PLD cores following the EMAC 
        format, which uses a device key to communicate the expansion devices available to 
        the kernel.       

config ECOREEX_TGPIO
		depends on ECOREEX
        bool "iPac True GPI/O expansion R1.0"
        ---help---
        Provides autodetection and support for the iPac GPI/O expansion

config ECOREEX_SGPWM
		depends on ECOREEX
        bool "iPac Shadow GPI/O & PWM expansion R1.0"
        ---help---
        Provides autodetection and support for the iPac Shadow GPI/O & PWM expansion

config ECOREEX_GCMB
		depends on ECOREEX
        bool "GCMB expansion I/O"
        ---help---
        Provides autodetection and support for the GCMB expansion

config ECOREEX_DENM
		depends on ECOREEX
        bool "DENM expansion I/O"
        ---help---
        Provides autodetection and support for the DENM expansion       

config ECOREEX_HWMS
        depends on ECOREEX
        bool "Armstrong HWMS expansion I/O"
        ---help---
        Provides support for the Armstrong HWMS PLD

config ECOREEX_RDAC
        depends on ECOREEX
        bool "RDAC Carrier expansion I/O"
        ---help---
        Provides support for the Blutick RDAC PLD

config ECOREEX_SOM150
        depends on ECOREEX
        bool "EMAC SoM-150-ES expansion I/O"
        ---help---
        Provides support for the EMAC SoM-150-ES PLD

config ECOREEX_KEY
        depends on ECOREEX
        bool "Define static version key"
        ---help---
        Disable auto-detection of the PLD core by defining the version key

config ECOREEX_STATIC_KEY
        depends on ECOREEX_KEY
        hex "Version key"
        default "0xC0"
        ---help---
        Set the static version key for the PLD core 

config BOARDSPEC
        tristate "board devices"
        ---help---
        Provides registration of devices provided by the mach. 

endmenu
```

## drivers/misc/classes/Kconfig
```kconfig
#
# Input device configuration
#

menu "misc device classes"

config GPIOCLASS
        bool "GPIO class"
        ---help---
	  This is a set of classes for general purpose io ports.
	  These devices typically contain a data register, 
	  which holds the current state of the pins, and a ddr register, 
	  which sets the pin to input or output, 0 or 1 respectively 

config GPIOCLASS_SYSFS
	depends on SYSFS && GPIOCLASS
        bool "sysfs interface"
        ---help---
	  Enables a sysfs interface to the gpio class

config GPIOCLASS_RTDM 
	depends on XENO_SKIN_RTDM && GPIOCLASS
        bool "rtdm interface"
        ---help---
	  Enables a Xenomai RTDM interface to the gpio class
	  
config GPIOCLASS_CHAR
	depends on GPIOCLASS
	bool "char interface"
	---help---
	  Enables a character device interface to the GPIO class.

config PWMCLASS
        bool "PWM class"
        ---help---
	  This is a set of classes for pulse width modulation.
	  It allows the creation of pwm classes which can be configured
	  through sysfs. PWM devices typically contain a 
	  duty and frequency configuration register.
	  
config PWMCLASS_SYSFS
	depends on SYSFS && PWMCLASS
        bool "sysfs interface"
        ---help---
	  enables a sysfs interface to the pwm class

config PWMCLASS_RTDM 
	depends on XENO_SKIN_RTDM && PWMCLASS
        bool "rtdm interface"
        ---help---
	  enables a Xenomai RTDM interface to the pwm class	  
	  
config SPICLASS
        bool "SPI class"
        ---help---
	  This is a set of classes for SPI interfaces.
	  It allows the creation of spi classes which can be configured
	  through sysfs.SPI devices typically contain a 
	  speed and flags register, a method for locking the bus, 
	  and a bidirectional "xmit" method.

config SPICLASS_SYSFS
	depends on SYSFS && SPICLASS
        bool "sysfs interface"
        ---help---
	  Enables a sysfs interface to the spi class

config SPICLASS_CHAR
	depends on SPICLASS
	bool "char interface"
	---help---
	  Enables a character device interface to the spi class.

config LSI2ESC
        depends on SPICLASS && SPI_MASTER
        bool "Linux SPI Interface to EMAC SPI Class interface"
        ---help---
          Enables a generic interface between the Linux SPI
          driver and the EMAC SPI Class. Boards with an SPI controller
          driver can use this to define generic access to a device
          through the EMAC SPI class.

config LSI2ESC_MCP3208
	depends on LSI2ESC && GPIOCLASS
	bool "MCP3208 ADC GPIO Interface"
	---help---
	  Enables an extension to the LSI2ESC to allow use of the SPI-based
	  MCP3208 ADC through the GPIO Class. The LSI2ESC interface for this
	  device must first be setup and registered in the board specific 
	  initialization code followed by a call to the class creation 
	  function in this driver.

config LSI2ESC_MCP4922
	depends on LSI2ESC && GPIOCLASS
	bool "MCP4922 DAC GPIO Interface"
	---help---
	  Enables an extension to the LSI2ESC to allow use of the SPI-based
	  MCP4922 DAC through the GPIO Class. The LSI2ESC interface for this
	  device must first be setup and registered in the board specific 
	  initialization code followed by a call to the class creation 
	  function in this driver.

config LSI2ESC_RDAC_AIO
	depends on LSI2ESC && GPIOCLASS && RDAC_CARRIER
	bool "RDAC Carrier AIO board GPIO interface"
	---help---
	  Enables an extension to the LSI2ESC to allow use of the SPI-based RDAC
	  Carrier board AIO expansion through the GPIO class. The driver is
	  instantiated through the LSI2ESC device created for this board. Creates
	  a GPIO device for every register (or register set) on the AIO board.

config LSI2ESC_RIMS_8051
	depends on LSI2ESC && GPIOCLASS && RIMS_MCB
	bool "RIMS MCB 8051 GPIO interface"
	---help---
	  Enables an extension to the LSI2ESC to allow use of the SPI-based RIMS
	  SOM to 8051 communication through the GPIO class. The driver is
	  instantiated through the LSI2ESC device created for this board. 

endmenu
```

## sound/spi/Kconfig
```kconfig
#SPI drivers

menuconfig SND_SPI
	bool "SPI sound devices"
	depends on SPI
	default y
	help
	  Support for sound devices connected via the SPI bus.

if SND_SPI

config SND_AT73C213
	tristate "Atmel AT73C213 DAC driver"
	depends on ATMEL_SSC
	select SND_PCM
	help
	  Say Y here if you want to use the Atmel AT73C213 external DAC. This
	  DAC can be found on Atmel development boards.

	  This driver requires the Atmel SSC driver for sound sink, a
	  peripheral found on most AT91 and AVR32 microprocessors.

	  To compile this driver as a module, choose M here: the module will be
	  called snd-at73c213.

config SND_AT73C213_TARGET_BITRATE
	int "Target bitrate for AT73C213"
	depends on SND_AT73C213
	default "48000"
	range 8000 50000
	help
	  Sets the target bitrate for the bitrate calculator in the driver.
	  Limited by hardware to be between 8000 Hz and 50000 Hz.

	  Set to 48000 Hz by default.

config SND_CS4271
	tristate "CS4271 driver"
	depends on ATMEL_SSC
	select SND_PCM
	help
	  Say Y here if you want to use the CS4271 codec. This
	  codec can be found on the EMAC Inc SOM-150 carrier.

	  This driver requires the Atmel SSC driver for sound sink, a
	  peripheral found on most AT91 and AVR32 microprocessors.

config SND_CS4271_TARGET_BITRATE
	int "Target bitrate for CS4271"
	depends on SND_CS4271
	default "48000"
	range 8000 50000
	help
	  Sets the target bitrate for the bitrate calculator in the driver.
	  Limited by hardware to be between 8000 Hz and 50000 Hz.

endif	# SND_SPI
```
